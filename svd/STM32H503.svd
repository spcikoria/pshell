# STM32H503 register map
File version: 1.5
CPU: CM33 r0p0, little endian, MPU, FPU, 4 interrupt priority bits
Registers are 32-bit, read-write, reset 0x0 unless marked. A register's access mark holds for its fields unless they carry their own. Offsets are from the block's base; lines under a group give offsets from that group; [hi:lo] are bit positions; {n}, {i} and the like mark numbered series; 'fields as' and 'values as' point back to an identical list; <NAME> marks a mode.

## Memory map
0x40000000 TIM2 size 0x400 — General-purpose timers
0x40000400 TIM3 size 0x400 — General-purpose timers
0x40001000 TIM6 size 0x400 — Basic timers
0x40001400 TIM7 size 0x400 — Basic timers
0x40002C00 WWDG size 0x400 — System window watchdog
0x40003000 IWDG size 0x400 — Independent watchdog
0x40003400 OPAMP1 size 0x400 — Operational amplifiers
0x40003800 SPI2 size 0x400
0x40003C00 SPI3 size 0x400
0x40004000 COMP size 0x400 — Comparator
0x40004400 USART2 size 0x400
0x40004800 USART3 size 0x400
0x40005400 I2C1 size 0x400 — Inter-integrated circuit
0x40005800 I2C2 size 0x400
0x40005C00 I3C1 size 0x400 — Improved inter-integrated circuit
0x40006000 CRS size 0x400 — Clock recovery system
0x40008C00 DTS size 0x400 — Digital temperature sensor
0x40009400 LPTIM2 size 0x400
0x4000A400 FDCAN1 size 0x400 — Controller area network
0x40012C00 TIM1 size 0x400 — Advanced-control timers
0x40013000 SPI1 size 0x400 — Serial peripheral interface
0x40013800 USART1 size 0x400 — Universal synchronous asynchronous receiver transmitter
0x40016000 USB size 0x400 — USB full speed
0x40020000 GPDMA1 size 0x1000 — General purpose direct memory access controller
0x40021000 GPDMA2 size 0x1000
0x40022000 FLASH size 0x400 — FLASH address block description
0x40023000 CRC size 0x400 — Cyclic redundancy check calculation unit
0x40026000 RAMCFG size 0x400 — RAMs configuration controller
0x40030400 ICACHE size 0x400 — Instruction cache
0x40032400 GTZC1 size 0x800 — Global privilege controller
0x42020000 GPIOA size 0x400 — General-purpose I/Os
0x42020400 GPIOB size 0x400 — General-purpose I/Os
0x42020800 GPIOC size 0x400 — General-purpose I/Os
0x42020C00 GPIOD size 0x400
0x42021C00 GPIOH size 0x400 — General-purpose I/Os
0x42028000 ADC size 0x400 — Analog to digital converter
0x42028400 DAC size 0x400 — Digital to analog converter
0x420C0400 HASH size 0x400 — Hash processor
0x420C0800 RNG size 0x400 — True random number generator
0x44000400 SBS size 0x150 — System configuration, boot and security
0x44002400 LPUART size 0x400 — Universal synchronous asynchronous receiver transmitter
0x44003000 I3C2 size 0x400
0x44004400 LPTIM1 size 0x400 — Low power timer
0x44007800 RTC size 0x400 — Real-time clock
0x44007C00 TAMP size 0x400 — Tamper and backup registers
0x44020800 PWR size 0x400 — Power control
0x44020C00 RCC size 0x400 — Reset and clock controller
0x44022000 EXTI size 0x400 — Extended interrupt/event controller
0x44024000 DBGMCU size 0x1000 — Microcontroller debug unit

## Interrupts
0 WWDG — Window Watchdog interrupt
2 RTC — RTC global interrupt
4 TAMP — TAMP global interrupt
5 RAMCFG — RAM configuration global interrupt
6 FLASH — FLASH non-secure global interrupt
9 RCC — RCC global interrupt
{n+11} EXTI{n} (EXTI) (n=0..15) — EXTI Line{n} interrupt
{n+27} GPDMA1_CH{n} (GPDMA1) (n=0..7) — GPDMA1 channel {n} global interrupt
35 IWDG — IWDG interrupt
37 ADC1 (ADC) — ADC1 global interrupt
38 DAC1 (DAC) — DAC1 global interrupt
39 FDCAN1_IT0 (FDCAN1) — FDCAN1 interrupt 0
40 FDCAN1_IT1 (FDCAN1) — FDCAN1 interrupt 1
41 TIM1_BRK_TERR_IERR (TIM1) — TIM1 break/TIM1 transition error/TIM1 index error
42 TIM1_UP (TIM1) — TIM1 Update
43 TIM1_TRG_COM_DIR_IDX (TIM1) — TIM1 trigger and commutation/TIM1 direction change interrupt/TIM1 index
44 TIM1_CC (TIM1) — TIM1 capture compare interrupt
45 TIM2 — TIM2 global interrupt
46 TIM3 — TIM3 global interrupt
49 TIM6 — TIM6 global interrupt
50 TIM7 — TIM7 global interrupt
51 I2C1_EV (I2C1) — I2C1 event interrupt
52 I2C1_ER (I2C1) — I2C1 error interrupt
53 I2C2_EV (I2C2) — I2C2 event interrupt
54 I2C2_ER (I2C2) — I2C2 error interrupt
55 SPI1 — SPI1 global interrupt
56 SPI2 — SPI2 global interrupt
57 SPI3 — SPI3 global interrupt
58 USART1 — USART1 global interrupt
59 USART2 — USART2 global interrupt
60 USART3 — USART3 global interrupt
63 LPUART1 (LPUART) — LPUART1 global interrupt
64 LPTIM1 — LPTIM1 global interrupt
70 LPTIM2 — LPTIM2 global interrupt
74 USB_FS (USB) — USB OTG FS global interrupt
75 CRS — Clock Recovery System global interrupt
{n+90} GPDMA2_CH{n} (GPDMA2) (n=0..7) — GPDMA2 channel {n} global interrupt
104 ICACHE — Instruction cache global interrupt
113 DTS_WKUP (DTS) — DTS interrupt or DTS AIT through EXTI line
114 RNG — RNG global interrupt
117 HASH — HASH interrupt
123 I3C1_EV (I3C1) — I3C1 event interrupt
124 I3C1_ER (I3C1) — I3C1 error interrupt
131 I3C2_EV (I3C2) — I3C2 event interrupt
132 I3C2_ER (I3C2) — I3C2 error interrupt
133 COMP — COMP global interrupt

## Notices in the file
Copyright (c) 2025 STMicroelectronics.
SPDX-License-Identifier: Apache-2.0
Licensed under the Apache License, Version 2.0 (the "License");
you may not use this file except in compliance with the License.
You may obtain a copy of the License at
http://www.apache.org/licenses/LICENSE-2.0
Unless required by applicable law or agreed to in writing, software
distributed under the License is distributed on an "AS IS" BASIS,
WITHOUT WARRANTIES OR CONDITIONS OF ANY KIND, either express or implied.
See the License for the specific language governing permissions and
limitations under the License.
